## config/boards/shieds/macropad_nrf52840/Kconfig.defconfig
```kconfig
if SHIELD_MACROPAD_NRF52840

config ZMK_KEYBOARD_NAME
    default "macropad_nrf52840"

endif
```

## config/boards/shieds/nrf52840_m2/Kconfig.shield
```kconfig
config SHIELD_MACROPAD_NRF52840
    def_bool $(shields_list_contains, macropad_nrf52840)
```
